## config/west.yml
```yaml
manifest:
  defaults:
    revision: v0.3
  remotes:
    - name: zmkfirmware
      url-base: https://github.com/zmkfirmware 
  projects:
    - name: zmk
      revision: zmkfirmware
      import: app/west.yml
  self:
    path: config
```
